/**
  ******************************************************************************
  * @file    ssd1306.c
  * @author  YANDLD
  * @date    2015.12.25
  * @brief   www.beyondcore.net   http://upcmcu.taobao.com 
  ******************************************************************************
  */

#include <string.h>
#include "ssd1306.h"
#include "gpio.h"
#include "common.h"

#ifndef ARRAY_SIZE
#define ARRAY_SIZE(x)	(sizeof(x) / sizeof((x)[0]))
#endif

#define SSD1306_ADDR        (0x3C)


#define OLED_SCLK_Pin    PTB21     //D0
#define OLED_SDIN_Pin    PTB23      //D1
#define OLED_RST_Pin     PTC1     //RST
#define OLED_DC_Pin      PTC3      //DC

/************************************6*8的点阵************************************/
const unsigned char F6x8[][6] =
{
	0x00, 0x00, 0x00, 0x00, 0x00, 0x00,// sp
	0x00, 0x00, 0x00, 0x2f, 0x00, 0x00,// !
	0x00, 0x00, 0x07, 0x00, 0x07, 0x00,// "
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	0x14, 0x14, 0x14, 0x14, 0x14, 0x14,// horiz lines
};

/***************************16*16的点阵字体取模方式：共阴——列行式——逆向输出*********/
unsigned char F16x16[] =
{
    0x40,0x48,0x48,0x48,0xFF,0x48,0x48,0x42,0xA2,0x9E,0x82,0xA2,0xC2,0xBE,0x00,0x00,
    0x80,0x60,0x1F,0x20,0x7F,0x44,0x44,0x40,0x4F,0x48,0x48,0x48,0x48,0x4F,0x40,0x00,//?0

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    0x04,0x44,0x82,0x7F,0x01,0x80,0x80,0x40,0x43,0x2C,0x10,0x28,0x46,0x81,0x80,0x00,//?3
};

 		     


//GPIO_WriteBit(HW_GPIOB, 11, 1);
static inline void WriteCmd(unsigned char cmd)//写命令
{
     GPIO_WriteBit(HW_GPIOC, 1, 0);
    //I2C_BurstWrite(0, SSD1306_ADDR, 0x00, 1, &cmd, 1);
    //OLED_CS_Clr();
  for(int i=0;i<8;i++)
  {
    //PTXn_T(OLED_SCLK_Pin,OUT)=0
      GPIO_WriteBit(HW_GPIOC, 3, 0);
    if(cmd&0x80)
      //OLED_SDIN_Set();
    GPIO_WriteBit(HW_GPIOC, 2, 1);
    else 
      //OLED_SDIN_Clr();
    GPIO_WriteBit(HW_GPIOC, 2, 0);
    //OLED_SCLK_Set();
    GPIO_WriteBit(HW_GPIOC, 3, 1);
    cmd<<=1;   
  }				 		  
  //OLED_CS_Set();
  //OLED_DC_Set();   
GPIO_WriteBit(HW_GPIOC, 1, 1);  
}
static inline void WriteDat(unsigned char data)//写数据
{
    GPIO_WriteBit(HW_GPIOC, 1, 1);
    //I2C_BurstWrite(0, SSD1306_ADDR, 0x00, 1, &cmd, 1);
    //OLED_CS_Clr();
  for(int i=0;i<8;i++)
  {
    //PTXn_T(OLED_SCLK_Pin,OUT)=0
      GPIO_WriteBit(HW_GPIOC, 3, 0);
    if(data&0x80)
      //OLED_SDIN_Set();
    GPIO_WriteBit(HW_GPIOC, 2, 1);
    else 
      //OLED_SDIN_Clr();
    GPIO_WriteBit(HW_GPIOC, 2, 0);
    //OLED_SCLK_Set();
    GPIO_WriteBit(HW_GPIOC, 3, 1);
    data<<=1;   
  }				 		  
  //OLED_CS_Set();
  //OLED_DC_Set();    
GPIO_WriteBit(HW_GPIOC, 1, 1);  
}



void ssd1306_init(void)
{
     GPIO_QuickInit(HW_GPIOC, 0, kGPIO_Mode_OPP);
     GPIO_QuickInit(HW_GPIOC, 1, kGPIO_Mode_OPP);
     GPIO_QuickInit(HW_GPIOC, 2, kGPIO_Mode_OPP);
     GPIO_QuickInit(HW_GPIOC, 3, kGPIO_Mode_OPP);
    
    
    GPIO_WriteBit(HW_GPIOC, 0, 1); 
 DelayMs(100);
    GPIO_WriteBit(HW_GPIOC, 0, 0); 
 DelayMs(200);
    GPIO_WriteBit(HW_GPIOC, 0, 1);  

	//DelayMs(100); //这里的延时很重要
	
    WriteCmd(0xAE); //display off
	WriteCmd(0x20);	//Set Memory Addressing Mode	
	WriteCmd(0x10);	//00,Horizontal Addressing Mode;01,Vertical Addressing Mode;10,Page Addressing Mode (RESET);11,Invalid
	WriteCmd(0xb0);	//Set Page Start Address for Page Addressing Mode,0-7
	WriteCmd(0xc8);	//Set COM Output Scan Direction
	WriteCmd(0x00); //---set low column address
	WriteCmd(0x10); //---set high column address
	WriteCmd(0x40); //--set start line address
	WriteCmd(0x81); //--set contrast control register
	WriteCmd(0xff); //亮度调节 0x00~0xff
	WriteCmd(0xa1); //--set segment re-map 0 to 127
	WriteCmd(0xa6); //--set normal display
	WriteCmd(0xa8); //--set multiplex ratio(1 to 64)
	WriteCmd(0x3F); //
	WriteCmd(0xa4); //0xa4,Output follows RAM content;0xa5,Output ignores RAM content
	WriteCmd(0xd3); //-set display offset
	WriteCmd(0x00); //-not offset
	WriteCmd(0xd5); //--set display clock divide ratio/oscillator frequency
	WriteCmd(0xf0); //--set divide ratio
	WriteCmd(0xd9); //--set pre-charge period
	WriteCmd(0x22); //
	WriteCmd(0xda); //--set com pins hardware configuration
	WriteCmd(0x12);
	WriteCmd(0xdb); //--set vcomh
	WriteCmd(0x20); //0x20,0.77xVcc
	WriteCmd(0x8d); //--set DC-DC enable
	WriteCmd(0x14); //
	WriteCmd(0xaf); //--turn on oled panel
    
    OLED_Fill(0x00);
}


void OLED_Fill(unsigned char dat)
{
    int i;
    unsigned char m;
    for(m=0;m<8;m++)
    {
        WriteCmd(0xb0+m);		//page0-page1
		WriteCmd(0x00);		//low column start address
        WriteCmd(0x10);		//high column start address
        for(i=0; i<128; i++)
        {
            WriteDat(dat); 
            
        }
        //I2C_BurstWrite(0,SSD1306_ADDR, 0x40, 1, buf, sizeof(buf));
	}
}

void OLED_SetPos(unsigned char x, unsigned char y) //设置起始点坐标
{ 
	WriteCmd(0xb0+y);
	WriteCmd(((x&0xf0)>>4)|0x10);
	WriteCmd((x&0x0f)|0x01);
}



void OLED_Enable(void)
{
	WriteCmd(0X8D);  //设置电荷泵
	WriteCmd(0X14);  //开启电荷泵
	WriteCmd(0XAF);  //OLED唤醒
}


void OLED_Disable(void)
{
	WriteCmd(0X8D);  //设置电荷泵
	WriteCmd(0X10);  //关闭电荷泵
	WriteCmd(0XAE);  //OLED休眠
}

void OLED_ShowStr(unsigned char x, unsigned char y, char *str)
{
	unsigned char c = 0,i = 0,j = 0;
    while(str[j] != '\0')
    {
        c = str[j] - 32;
        if(x > 126)
        {
            x = 0;
            y++;
        }
        OLED_SetPos(x,y);
        for(i=0;i<6;i++)
            WriteDat(F6x8[c][i]);
        x += 6;
        j++;
    }
}

void OLED_ShowCN(unsigned char x, unsigned char y, unsigned char N)
{
	unsigned char wm=0;
	unsigned int  adder=32*N;
	OLED_SetPos(x , y);
	for(wm = 0;wm < 16;wm++)
	{
		WriteDat(F16x16[adder]);
		adder += 1;
	}
	OLED_SetPos(x,y + 1);
	for(wm = 0;wm < 16;wm++)
	{
		WriteDat(F16x16[adder]);
		adder += 1;
	}
}
//void OLED_DrawBMP(int xSize, int ySize, uint8_t** ppData)
   void OLED_DrawBMP(unsigned char x0,unsigned char y0,unsigned char high,unsigned char width,unsigned char *p)
{
	    unsigned int i,j;
    unsigned int temp,temp1;
    unsigned char dat;
    
    
    temp1 = high%8;
    if(temp1 == 0) temp = high/8;
    else           temp = high/8+1;
    
 
    for(i=0; i<temp; i++)
    {
        OLED_SetPos(0,i);
        for(j=0; j<width; j++)
        {
            dat = 0;
            if( i<(temp-1) || !temp1 || temp1>=1)dat |= (*(p+i*8*width+j+width*0) > 0? 1: 0)<<0;
            if( i<(temp-1) || !temp1 || temp1>=2)dat |= (*(p+i*8*width+j+width*1) > 0? 1: 0)<<1;
            if( i<(temp-1) || !temp1 || temp1>=3)dat |= (*(p+i*8*width+j+width*2) > 0? 1: 0)<<2;
            if( i<(temp-1) || !temp1 || temp1>=4)dat |= (*(p+i*8*width+j+width*3) > 0? 1: 0)<<3;
            if( i<(temp-1) || !temp1 || temp1>=5)dat |= (*(p+i*8*width+j+width*4) > 0? 1: 0)<<4;
            if( i<(temp-1) || !temp1 || temp1>=6)dat |= (*(p+i*8*width+j+width*5) > 0? 1: 0)<<5;
            if( i<(temp-1) || !temp1 || temp1>=7)dat |= (*(p+i*8*width+j+width*6) > 0? 1: 0)<<6;
            if( i<(temp-1) || !temp1 || temp1>=8)dat |= (*(p+i*8*width+j+width*7) > 0? 1: 0)<<7;
            WriteDat(dat);
        }
    }
    /*unsigned int i,j;
    unsigned char temp,temp1,y3;
    unsigned char dat;
    
    y3=y1/8;
    temp1 = x1%8;
    if(temp1 == 0) temp = x1/8;
    else           temp = x1/8+1;
    
 
    for(i=0; i<temp; i++)
    {
        OLED_SetPos(0,i);
        for(j=0; j<y1; j++)
        {
            dat = 0;
            if( i<(temp-1) || !temp1 || temp1>=1)dat |= (BMP[(i*8+0)*y3+j/8+1]&(1<<(j%8))?1:0)<<0;
            if( i<(temp-1) || !temp1 || temp1>=2)dat |= (BMP[(i*8+1)*y3+j/8+1]&(1<<(j%8))?1:0)<<1;
            if( i<(temp-1) || !temp1 || temp1>=3)dat |= (BMP[(i*8+2)*y3+j/8+1]&(1<<(j%8))?1:0)<<2;
            if( i<(temp-1) || !temp1 || temp1>=4)dat |= (BMP[(i*8+3)*y3+j/8+1]&(1<<(j%8))?1:0)<<3;
            if( i<(temp-1) || !temp1 || temp1>=5)dat |= (BMP[(i*8+4)*y3+j/8+1]&(1<<(j%8))?1:0)<<4;
            if( i<(temp-1) || !temp1 || temp1>=6)dat |= (BMP[(i*8+5)*y3+j/8+1]&(1<<(j%8))?1:0)<<5;
            if( i<(temp-1) || !temp1 || temp1>=7)dat |= (BMP[(i*8+6)*y3+j/8+1]&(1<<(j%8))?1:0)<<6;
            if( i<(temp-1) || !temp1 || temp1>=8)dat |= (BMP[(i*8+7)*y3+j/8+1]&(1<<(j%8))?1:0)<<7;
           WriteDat(dat);
        }
    }*/
    /*
    unsigned int j=0;
	unsigned char x,y;

  if(y1%8==0)
		y1 = y1/8;
  else
		y1 = y1/8 + 1;
	for(x=x0;x<x1;x++)
	{
		
    for(y=y0;y<y1;y++)
		{
            
            OLED_SetPos(x,y1-y);
			WriteDat(BMP[j++]);
		}
	}
   */
}


